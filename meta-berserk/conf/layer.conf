## meta-berserk/conf/layer.conf
```bitbake
# We have a conf and classes directory, add to BBPATH
BBPATH .= ":${LAYERDIR}"

# We have a packages directory, add to BBFILES
BBFILES += "${LAYERDIR}/recipes-*/*/*.bb \
            ${LAYERDIR}/recipes-*/*/*.bbappend"


# BerSerk
BBFILE_COLLECTIONS += "bs"
BBFILE_PATTERN_bs := "^${LAYERDIR}/"
BBFILE_PRIORITY_bs = "5"


DISTRO_FEATURES_append += " wifi x11"

PREFERRED_VERSION_ffmpeg = "3.1.11"
SYSVINIT_ENABLED_GETTYS  = "1"

PREFERRED_VERSION_linux-raspberrypi ?= "4.9%"
```
